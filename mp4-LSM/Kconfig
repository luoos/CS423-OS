## mp4-LSM/Kconfig
```kconfig
config SECURITY_MP4_LSM
        bool "CS423 machine problem 4 support"
        depends on NET
        depends on SECURITY
        select NETLABEL
        select SECURITY_NETWORK
        default n
        help
          This selects the cs423 machine problem 4 security lsm to be compiled with the kernel.
          If you are unsure how to answer this question, answer N.
```
